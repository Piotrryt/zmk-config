## config/boards/shield/mycorne/Kconfig.shield
```kconfig
# Copyright (c) 2020 Pete Johanson
# SPDX-License-Identifier: MIT

config SHIELD_MYCORNE_LEFT
    def_bool $(shields_list_contains,mycorne_left)

config SHIELD_MYCORNE_RIGHT
    def_bool $(shields_list_contains,mycorne_right)
```

## config/boards/shields/rycerzkbd/Kconfig.shield
```kconfig
# Copyright (c) 2020 Pete Johanson
# SPDX-License-Identifier: MIT

config SHIELD_RYCERZKBD_LEFT
    def_bool $(shields_list_contains,rycerzkbd_left)

config SHIELD_RYCERZKBD_RIGHT
    def_bool $(shields_list_contains,rycerzkbd_right)
```

## config/west.yml
```yaml
manifest:
  remotes:
    - name: Piotrryt
      url-base: https://github.com/Piotrryt
  projects:
    - name: zmk
      remote: Piotrryt
      revision: main
      import: app/west.yml
  self:
    path: config
```
